## Documentation/devicetree/bindings/arm/davinci.txt
```
Texas Instruments DaVinci Platforms Device Tree Bindings
--------------------------------------------------------

DA850/OMAP-L138/AM18x Evaluation Module (EVM) board
Required root node properties:
    - compatible = "ti,da850-evm", "ti,da850";

EnBW AM1808 based CMC board
Required root node properties:
    - compatible = "enbw,cmc", "ti,da850;

Generic DaVinci Boards
----------------------

DA850/OMAP-L138/AM18x generic board
Required root node properties:
    - compatible = "ti,da850";

System Configuration
--------------------

Required syscon node: some subnode of the soc node must be a
  system controller node pointing to the CFGCHIPn registers,
  with the compatible string set to "ti,da830-cfgchip", "syscon"

Example:

cfgchip: cfgchip@1417c {
	compatible = "ti,da830-cfgchip", "syscon";
	reg = <0x1417c 0x14>;
};
```

## Documentation/devicetree/bindings/clock/keystone-gate.txt
```
Status: Unstable - ABI compatibility may be broken in the future

Binding for Keystone gate control driver which uses PSC controller IP.

This binding uses the common clock binding[1].

[1] Documentation/devicetree/bindings/clock/clock-bindings.txt

Required properties:
- compatible : shall be "ti,keystone,psc-clock".
- #clock-cells : from common clock binding; shall be set to 0.
- clocks : parent clock phandle
- reg :	psc address space
- power-domain : psc power domain id
- module-domain: psc module (clock) domain id (lpsc)

Optional properties:
- clock-output-names : From common clock binding to override the
			default output clock name
Example:
	clkusb: clkusb {
		#clock-cells = <0>;
		compatible = "ti,keystone,psc-clock";
		clocks = <&chipclk16>;
		clock-output-names = "usb";
		reg = <0x02350000 0x400>;
		power-domain = <0>;
		module-domain = <2>;
	};
```

## Documentation/devicetree/bindings/clock/keystone-pll.txt
```
Status: Unstable - ABI compatibility may be broken in the future

Binding for keystone PLLs. The main PLL IP typically has a multiplier,
a divider and a post divider. The additional PLL IPs like ARMPLL, DDRPLL
and PAPLL are controlled by the memory mapped register where as the Main
PLL is controlled by a PLL controller registers along with memory mapped
registers.

Binding is also used for davinci PLLs.

This binding uses the common clock binding[1].

[1] Documentation/devicetree/bindings/clock/clock-bindings.txt

Required properties:
- #clock-cells : from common clock binding; shall be set to 0.
- compatible : shall be "ti,keystone,main-pll-clock", "ti,keystone,pll-clock"
		or "ti,davinci,pll-clock"
- clocks : parent clock phandle
- reg - pll registers
- reg-names : control, multiplier, pre-divider and post-divider.
		"ti,keystone,main-pll-clock" requires control, multiplier and
		post-divider. "ti,keystone,pll-clock" requires only control.
		"ti,davinci,pll-clock" requires multiplier and post-divider and
		optionally uses pre-divider. In all cases, post-divider is
		omitted when using fixed-postdiv.
- fixed-postdiv : fixed post divider value. If absent, use clkod register bits
		for postdiv

Example:
	mainpllclk: mainpllclk@2310110 {
		#clock-cells = <0>;
		compatible = "ti,keystone,main-pll-clock";
		clocks = <&refclksys>;
		reg = <0x02620350 4>, <0x02310110 4>, <0x02310108 4>;
		reg-names = "control", "multiplier", "post-divider";
	};

	papllclk: papllclk@2620358 {
		#clock-cells = <0>;
		compatible = "ti,keystone,pll-clock";
		clocks = <&refclkpass>;
		clock-output-names = "pa-pll-clk";
		reg = <0x02620358 4>;
		reg-names = "control";
		fixed-postdiv = <2>;
	};

	pll0: pll@1c10000 {
		#clock-cells = <0>;
		compatible = "ti,davinci,pll-clock";
		clocks = <&oscin>;
		clock-output-names = "pll0";
		reg = <0x11114 4>, <0x11110 4>, <0x11128 4>;
		reg-names = "pre-divider", "multiplier", "post-divider";
	};


Required properties:
- #clock-cells : from common clock binding; shall be set to 0.
- compatible : shall be "ti,keystone,pll-mux-clock"
- clocks : link phandles of parent clocks
- reg - pll mux register
- bit-shift : number of bits to shift the bit-mask
- bit-mask : arbitrary bitmask for programming the mux

Optional properties:
- clock-output-names : From common clock binding.

Example:
	mainmuxclk: mainmuxclk@2310108 {
		#clock-cells = <0>;
		compatible = "ti,keystone,pll-mux-clock";
		clocks = <&mainpllclk>, <&refclkmain>;
		reg = <0x02310108 4>;
		bit-shift = <23>;
		bit-mask = <1>;
		clock-output-names = "mainmuxclk";
	};

Required properties:
- #clock-cells : from common clock binding; shall be set to 0.
- compatible : shall be "ti,keystone,pll-divider-clock"
- clocks : parent clock phandle
- reg - pll mux register
- bit-shift : number of bits to shift the bit-mask
- bit-mask : arbitrary bitmask for programming the divider

Optional properties:
- clock-output-names : From common clock binding.

Example:
	gemtraceclk: gemtraceclk@2310120 {
		#clock-cells = <0>;
		compatible = "ti,keystone,pll-divider-clock";
		clocks = <&mainmuxclk>;
		reg = <0x02310120 4>;
		bit-shift = <0>;
		bit-mask = <8>;
		clock-output-names = "gemtraceclk";
	};
```

## Documentation/devicetree/bindings/clock/ti/davinci/da8xx-cfgchip-gate.txt
```
Binding for TI DA8XX/OMAP-L13X/AM17XX/AM18XX CFGCHIP gate clocks

TI DA8XX/OMAP-L13X/AM17XX/AM18XX SoCs contain a general purpose set of
registers call CFGCHIPn. Some of these registers function as clock
gates. This document describes the bindings for those clocks.

Required properties:
- compatible: shall be "ti,da830-tbclksync".
- #clock-cells: from common clock binding; shall be set to 0.
- clocks: phandle to the parent clock

Optional properties:
- clock-output-names: from common clock binding.

Parent:
This node must be a child of a "ti,da830-cfgchip" node. 

Assignment:
The assigned-clocks and assigned-clock-parents from the common clock bindings
can be used to indicate which parent clock should be used.

Examples:

	cfgchip: syscon@1417c {
		compatible = "ti,da830-cfgchip", "syscon", "simple-mfd";
		reg = <0x1417c 0x14>;

		ehrpwm_tbclk: tbclk {
			compatible = "ti,da830-tbclksync";
			#clock-cells = <0>;
			clocks = <&psc1 17>;
			clock-output-names = "ehrpwm_tbclk";
		};
	};

Also see:
- Documentation/devicetree/bindings/clock/clock-bindings.txt
```

## Documentation/devicetree/bindings/clock/ti/davinci/da8xx-cfgchip-mux.txt
```
Binding for TI DA8XX/OMAP-L13X/AM17XX/AM18XX CFGCHIP multiplexer clocks

TI DA8XX/OMAP-L13X/AM17XX/AM18XX SoCs contain a general purpose set of
registers call CFGCHIPn. Some of these registers function as clock
multiplexers. This document describes the bindings for those clocks.

Required properties:
- compatible: shall be "ti,da850-async3-clock".
- #clock-cells: from common clock binding; shall be set to 0.
- clocks: phandle list of clocks corresponding to clock-names
- clock-names: must include the following: "pll0_sysclk2", "pll1_sysclk2".

Optional properties:
- clock-output-names: from common clock binding.

Parent:
This node must be a child of a "ti,da830-cfgchip" node.

Assignment:
The assigned-clocks and assigned-clock-parents from the common clock bindings
can be used to indicate which parent clock should be used.

Examples:

        cfgchip: syscon@1417c {
                compatible = "ti,da830-cfgchip", "syscon", "simple-mfd";
                reg = <0x1417c 0x14>;

                async3_clk: async3 {
                        compatible = "ti,da850-async3-clock";
                        #clock-cells = <0>;
                        clocks = <&pll0_sysclk 2>, <&pll1_sysclk 2>;
                        clock-names = "pll0_sysclk2", "pll1_sysclk2";
                        assigned-clocks = <&async3_clk>;
                        assigned-clock-parents = <&pll1_sysclk 2>;
                        clock-output-names = "async3";
                };
        };

Also see:
- Documentation/devicetree/bindings/clock/clock-bindings.txt
```

## Documentation/devicetree/bindings/clock/ti/davinci/da8xx-cfgchip-usb-phy.txt
```
Binding for TI DA8XX/OMAP-L13X/AM17XX/AM18XX CFGCHIP USB PHY clocks

TI DA8XX/OMAP-L13X/AM17XX/AM18XX SoCs contain a general purpose set of
registers call CFGCHIPn. Some of these registers function as the USB PHY
clocks. This document describes the bindings for those clocks.

The USB PHY clock node provides two clocks. The clock at index 0 is the USB 2.0
PHY clock and the clock at index 1 is the USB 1.1 PHY clock.

Required properties:
- compatible: shall be "ti,da830-usb-phy-clocks"
- #clock-cells: from common clock binding; shall be set to 1.
- clocks: Shall be a phandle to the USB 2.0 PSC clock

Parent:
	This node must be a child of a "ti,da830-cfgchip" node. 

Assignment:
	The assigned-clocks and assigned-clock-parents properties from the
	common clock bindings can be used to indicate which parent clock is
	being used. The parent of the USB 2.0 PHY clock (index 0) can be
	either an external 48MHz clock named "usb_refclkin" or the AUXCLK
	("pll0_auxclk"). The parent of the USB 1.1 PHY clock (index 1) can
	be the same external 48MHz clock or it can be the USB 2.0 PHY clock.

Examples:

	/* using internal SoC clocks */
	cfgchip: syscon@1417c {
		compatible = "ti,da830-cfgchip", "syscon", "simple-mfd";
		reg = <0x1417c 0x14>;

		usb_phy_clk: usb-phy-clocks {
			compatible = "ti,da830-usb-phy-clocks";
			#clock-cells = <1>;
			clocks = <&psc1 1>;
			assigned-clocks = <&usb_phy_clk 0>, <&usb_phy_clk 1>;
			assigned-clock-parents = <&pll0_auxclk>, <&usb_phy_clk 0>;
		};
	};

	/* using external reference clock */
	usb_refclkin: usb_refclkin {
		compatible = "fixed-clock";
		#clock-cells = <0>;
		clock-frequency = <48000000>;
		clock-output-names = "usb_refclkin";
	};
	...
	cfgchip: syscon@1417c {
		compatible = "ti,da830-cfgchip", "syscon", "simple-mfd";
		reg = <0x1417c 0x14>;

		usb_phy_clk: usb-phy-clocks {
			compatible = "ti,da830-usb-phy-clocks";
			#clock-cells = <1>;
			clocks = <&psc1 1>;
			assigned-clocks = <&usb_phy_clk 0>, <&usb_phy_clk 1>;
			assigned-clock-parents = <&usb_refclkin>, <&usb_refclkin>;
		};
	};

Also see:
- Documentation/devicetree/bindings/clock/clock-bindings.txt
```

## Documentation/devicetree/bindings/clock/ti/davinci/pll.txt
```
Binding for TI DaVinci PLL Controllers

The PLL provides clocks to most of the components on the SoC. In addition
to the PLL itself, this controller also contains bypasses, gates, dividers,
an multiplexers for various clock signals.

Required properties:
- compatible: shall be one of:
	- "ti,da850-pll0" for PLL0 on DA850/OMAP-L138/AM18XX
	- "ti,da850-pll1" for PLL1 on DA850/OMAP-L138/AM18XX
- reg: physical base address and size of the controller's register area.
- clocks: phandle to the PLL input clock source

Optional child nodes:

sysclk
	Describes the PLLDIVn divider clocks that provide the SYSCLKn clock
	domains. The node name must be "sysclk". Consumers of this node should
	use "n" in "SYSCLKn" as the parameter for the clock cell.

	Required properties:
	- #clock-cells: must be 1

auxclk
	Describes the AUXCLK output of the PLL. The node name must be "auxclk".

	Required properties:
	- #clock-cells: must be 0

Examples:

	pll0: clock-controller@11000 {
		compatible = "ti,da850-pll0";
		reg = <0x11000 0x1000>;
		clocks = <&ref_clk>;

		pll0_sysclk: sysclk {
			#clock-cells = <1>;
		};

		pll0_aux_clk: auxclk {
			#clock-cells = <0>;
		};
	};

Also see:
- Documentation/devicetree/bindings/clock/clock-bindings.txt
```

## Documentation/devicetree/bindings/clock/ti/davinci/psc.txt
```
Binding for TI DaVinci Power Sleep Controller (PSC)

The PSC provides power management, clock gating and reset functionality. It is
primarily used for clocking.

Required properties:
- compatible: shall be one of:
	- "ti,da850-psc0" for PSC0 on DA850/OMAP-L138/AM18XX
	- "ti,da850-psc1" for PSC1 on DA850/OMAP-L138/AM18XX
- reg: physical base address and size of the controller's register area.
- #clock-cells: from common clock binding; shall be set to 1.
- #reset-cells: from reset binding; shall be set to 1.

Consumers:

	Clock and reset consumers shall use the local power domain module ID
	(LPSC) as the index corresponding to the clock cell. Refer to the
	device-specific	datasheet to find these numbers. NB: Most local domains
	only provide a clock and not a reset.

Examples:

	psc0: clock-controller@10000 {
		compatible = "ti,da850-psc0";
		reg = <0x10000 0x1000>;
		#clock-cells = <1>;
		#reset-cells = <1>;
	};

	/* consumer */
	dsp: dsp@11800000 {
		compatible = "ti,da850-dsp";
		reg = <0x11800000 0x40000>,
		      <0x11e00000 0x8000>,
		      <0x11f00000 0x8000>,
		      <0x01c14044 0x4>,
		      <0x01c14174 0x8>;
		reg-names = "l2sram", "l1pram", "l1dram", "host1cfg", "chipsig";
		interrupt-parent = <&intc>;
		interrupts = <28>;
		clocks = <&psc0 15>;
		resets = <&psc0 15>;
	};

Also see:
- Documentation/devicetree/bindings/clock/clock-bindings.txt
- Documentation/devicetree/bindings/reset/reset.txt
```

## Documentation/devicetree/bindings/phy/phy-da8xx-usb.txt
```
TI DaVinci DA8XX USB PHY

Required properties:
 - compatible: must be "ti,da830-usbphy".
 - #phy-cells: must be 1.
 - reg : Address and length of the CFGCHIP2 register.

This device controls the PHY for both the USB 1.1 OHCI and USB 2.0 OTG
controllers on DA8XX SoCs. Consumers of this device should use index 1 for
the USB 1.1 phy device and index 2 for the USB 2.0 phy device.

Example:

	usbphy: usbphy@1c14184 {
		compatible = "ti,da830-usbphy";
		#phy-cells = <1>;
		reg = <0x14184 4>;
	};

	usb11: usb11@1e25000 {
		compatible = "ti,da830-ohci";
		reg = <0x225000 0x1000>;
		interrupts = <59>;
		phys = <&usbphy 1>;
		phy-names = "usbphy";
	};

	usb20: usb@1e00000 {
		compatible = "ti,da830-musb";
		reg = <0x200000 0x1000>;
		interrupts = <58>;
		phys = <&usbphy 2>;
		phy-names = "usbphy";
	};
```

## Documentation/devicetree/bindings/pinctrl/ti,da850-pinconf.txt
```
* Pin configuration for TI DA850/OMAP-L138/AM18x

These SoCs have a separate controller for setting bias (internal pullup/down).
Bias can only be selected for groups rather than individual pins.

Required Properties:

  - compatible: Must be "ti,da850-pinconf"
  - reg: Base address and length of each memory resource used by the pin
    controller hardware module.

The controller node also acts as a container for pin group configuration nodes.
The names of these groups are ignored.

Pin Group Node Properties:

- groups: An array of strings, each string containing the name of a pin group.
          Valid names are "cp0".."cp31".

The pin configuration parameters use the generic pinconf bindings defined in
pinctrl-bindings.txt in this directory. The supported parameters are
bias-disable, bias-pull-up, bias-pull-down.


Example
-------

In common dtsi file:

	pinconf: pin-controller@22c00c {
		compatible = "ti,da850-pinconf";
		reg = <0x22c00c 0x8>;
	};

In board-specific file

	&pinconf {
		pinctrl-0 = <&bias_disable_groups>;
		pinctrl-names = "default";

		bias_disable_groups: bias_disable {
			groups = "cp0", "cp2", "cp4", "cp5";
			bias-disable;
		};
	};
```

## Documentation/devicetree/bindings/timer/ti,davinci-timer.txt
```
* Device tree bindings for Texas Instruments DaVinci timer

This document provides bindings for the 64-bit timer in the DaVinci
architecture devices. The timer can be configured as a general-purpose 64-bit
timer, dual general-purpose 32-bit timers. When configured as dual 32-bit
timers, each half can operate in conjunction (chain mode) or independently
(unchained mode) of each other.

It is global timer is a free running up-counter and can generate interrupt
when the counter reaches preset counter values.

Required properties:

- compatible : should be "ti,davinci-timer".
- reg : specifies base physical address and count of the registers.
- clocks : the clock feeding the timer clock.

Example:

	clocksource: timer@20000 {
		compatible = "ti,davinci-timer";
		reg = <0x20000 0x1000>;
		clocks = <&pll0_auxclk>;
	};
```
